## CMakeLists.txt
```
cmake_minimum_required(VERSION 3.20.0)
find_package(Zephyr REQUIRED HINTS $ENV{ZEPHYR_BASE})

project(nes_emulator CXX C)

target_include_directories(app PRIVATE include)

target_sources(app PRIVATE
    src/main.cpp
    src/video/virtual_screen.cpp
    src/cpu/cpu_core.cpp
    src/cpu/cpu_instructions.cpp
    src/cpu/cpu_utils.cpp
    src/cpu/address_logic.cpp
    src/ppu/ppu.cpp
    src/ppu/ppu_helpers.cpp
    src/bus/bus.cpp
    src/bus/memory.cpp
    src/bus/cartridge.cpp
    src/bus/globals.cpp
    src/input/nes_controller.cpp
    src/video/fb_udp.c
)

# Embed the NES ROM directly into the firmware image as a C byte array.
# Override with -DNES_ROM=/abs/path/to/game.nes at configure time.
# Default points at the smb.bin used during development.
set(NES_ROM "$ENV{HOME}/ZephyrOpensource/ADI_Temp/Licenta/smb.bin"
    CACHE FILEPATH "Path to the NES ROM to embed in the firmware")

if(NOT EXISTS "${NES_ROM}")
    message(FATAL_ERROR "NES_ROM not found: ${NES_ROM}\n"
                        "Pass -DNES_ROM=/path/to/game.nes to west build.")
endif()

# Write into include/generated (already on the system include path) so the
# array can be pulled in with #include <nes_rom.inc>.
generate_inc_file_for_target(app "${NES_ROM}"
    ${ZEPHYR_BINARY_DIR}/include/generated/nes_rom.inc)
```

## prj.conf
```kconfig
# PL310 L2 outer cache. Was disabled to isolate an earlier boot hang; re-enabled
# for performance now that CONFIG_NOCACHE_MEMORY=y handles GEM DMA coherency
# (the usual cause of PL310-related hangs on this SoC).
CONFIG_SOC_XILINX_PL310=y

# Optimize for speed — the NES core is a compute-bound interpreter, default
# -Os leaves a lot on the table.
CONFIG_SPEED_OPTIMIZATIONS=y

# C++ support
CONFIG_CPP=y
CONFIG_STD_CPP17=y
CONFIG_REQUIRES_FLOAT_PRINTF=n

# Logging — IMMEDIATE so messages print synchronously instead of being queued
# for a low-priority log thread that the busy emu thread never lets run.
CONFIG_LOG=y
CONFIG_LOG_DEFAULT_LEVEL=3
CONFIG_LOG_MODE_IMMEDIATE=y

# ROM embedded in the firmware image at build time (see CMakeLists.txt) — no SD driver needed

# Threading
CONFIG_MULTITHREADING=y
CONFIG_MAIN_STACK_SIZE=4096

# Heap for filesystem buffers
CONFIG_HEAP_MEM_POOL_SIZE=32768

# GPIO for NES controller
CONFIG_GPIO=y

# Random number generation (needed by network stack)
CONFIG_ENTROPY_GENERATOR=y
CONFIG_TEST_RANDOM_GENERATOR=y

# Networking - TCP framebuffer streaming (reliable, flow-controlled: no dropped
# frames, emulator paced by the link instead of overflowing TX buffers)
CONFIG_NETWORKING=y
CONFIG_NET_SOCKETS=y
CONFIG_NET_TCP=y
CONFIG_NET_UDP=y
CONFIG_NET_IPV4=y
CONFIG_NET_IF_UNICAST_IPV4_ADDR_COUNT=1
CONFIG_NET_CONFIG_SETTINGS=y
# net_config_init() blocks before main() until the link is up, default 30 s.
# fb_udp waits for the interface itself, so don't stall boot for the full 30 s.
CONFIG_NET_CONFIG_INIT_TIMEOUT=2
CONFIG_NET_CONFIG_MY_IPV4_ADDR="192.0.2.3"
CONFIG_NET_CONFIG_MY_IPV4_GW="192.0.2.1"
CONFIG_NET_CONFIG_MY_IPV4_NETMASK="255.255.255.0"

# Ethernet driver menu + L2 layer — REQUIRED. Without both, the whole
# ethernet driver menu is off and CONFIG_ETH_XLNX_GEM below is silently
# ignored (no interface, no link).
CONFIG_ETH_DRIVER=y
CONFIG_NET_L2_ETHERNET=y
CONFIG_ETH_XLNX_GEM=y

# Place the GEM DMA buffer-descriptor rings in non-cached RAM. The Zynq-7000
# GEM DMA does not snoop the cache, so caching the rings causes coherency
# stalls / silent hangs. (Same setting zperf uses on this board.)
CONFIG_NOCACHE_MEMORY=y

# Bulk RX/TX at 1G needs deeper network thread stacks than the default.
CONFIG_NET_TX_STACK_SIZE=65536
CONFIG_NET_RX_STACK_SIZE=65536
CONFIG_NET_PKT_RX_COUNT=16
CONFIG_NET_PKT_TX_COUNT=64
CONFIG_NET_BUF_RX_COUNT=64
CONFIG_NET_BUF_TX_COUNT=256
```

## src/main.cpp
```c
#include <zephyr/kernel.h>
#include <zephyr/logging/log.h>
#include <zephyr/sys/device_mmio.h>
#include <string.h>

#include "bus.h"
#include "cartridge.h"
#include "cpu.h"
#include "ppu.h"
#include "virtual_screen.h"
#include "nes_controller.h"
#include "fb_udp.h"

LOG_MODULE_REGISTER(nes_main, LOG_LEVEL_INF);

static volatile uint8_t *bram_fb;

#define ROM_PATH "" /* ROM loaded by U-Boot into RAM, path unused */

#define EMU_STACK_SIZE    8192
#define INPUT_STACK_SIZE  1024
#define EMU_PRIORITY      5
#define INPUT_PRIORITY    4   /* higher priority than emulator so input is always fresh */

extern uint8_t pixels[256 * 240];
extern volatile bool RENDER_ENABLED;

/* Shared controller byte — input thread writes, emulator thread reads */
static volatile uint8_t controller_byte;

/* Gate the emulator until the network is up. The emu thread busy-spins and
 * would otherwise starve the lower-priority net stack threads (PHY link poll,
 * net-mgmt, config), so the interface would never come up. Set true only after
 * fb_udp_init() has the interface ready. */
static volatile bool net_ready;

/* ------------------------------------------------------------------ */
/* Input thread: polls the NES controller every 10ms                  */
/* ------------------------------------------------------------------ */

static void input_thread_fn(void *p1, void *p2, void *p3)
{
    ARG_UNUSED(p1);
    ARG_UNUSED(p2);
    ARG_UNUSED(p3);

    while (1) {
        controller_byte = nes_controller_read();
        k_msleep(10);
    }
}

K_THREAD_DEFINE(input_thread, INPUT_STACK_SIZE,
                input_thread_fn, NULL, NULL, NULL,
                INPUT_PRIORITY, 0, 0);

/* ------------------------------------------------------------------ */
/* Emulation thread                                                    */
/* ------------------------------------------------------------------ */

static bool leap_cycle;

static void emu_thread_fn(void *p1, void *p2, void *p3)
{
    ARG_UNUSED(p1);
    ARG_UNUSED(p2);
    ARG_UNUSED(p3);

    LOG_INF("Emulation thread started");

    /* Wait for networking to come up before busy-spinning, otherwise this
     * thread starves the net stack and the interface never initialises.
     * k_msleep() yields to all lower-priority threads (unlike k_yield()). */
    while (!net_ready) {
        k_msleep(50);
    }
    LOG_INF("Network ready — emulation running");

    uint32_t emu_us = 0, send_us = 0;
    int prof = 0;

    /* Real-time frame pacing. The NES runs at ~60 Hz; the emulator is far
     * faster than that, so without throttling the game plays at several times
     * normal speed. We compute each frame's deadline as an absolute tick count
     * from a fixed base (base + frame * TICKS_PER_SEC / NES_FPS) — multiplying
     * before dividing keeps rounding from accumulating, so the cadence stays
     * locked to 60 Hz with no long-term drift. */
    const int NES_FPS = 60;
    int64_t base_ticks = k_uptime_ticks();
    uint64_t frame = 0;

    while (1) {
        uint32_t t0 = k_cycle_get_32();

        /* Emulate exactly one NES frame. ppu_render_scanline() advances the
         * scanline counter and sets RENDER_ENABLED when it wraps past the last
         * scanline, marking the frame boundary. */
        do {
            ppu_render_scanline();

            int cpu_ticks = 113 + (leap_cycle ? 1 : 0);
            leap_cycle = !leap_cycle;

            for (int j = 0; j < cpu_ticks; j++) {
                cpu_clock();
            }
        } while (!RENDER_ENABLED);

        controller[0] = controller_byte;
        RENDER_ENABLED = false;

        uint32_t t1 = k_cycle_get_32();

        memcpy((void *)bram_fb, pixels, 256 * 240);
        fb_udp_send_frame(pixels, 256, 240);

        uint32_t t2 = k_cycle_get_32();

        emu_us += k_cyc_to_us_floor32(t1 - t0);
        send_us += k_cyc_to_us_floor32(t2 - t1);
        if (++prof >= NES_FPS) {
            LOG_INF("avg/frame: emu=%u us  send=%u us  (capped ~%u fps)",
                    emu_us / NES_FPS, send_us / NES_FPS, NES_FPS);
            emu_us = send_us = 0;
            prof = 0;
        }

        /* Sleep until this frame's absolute deadline. If emulation+send already
         * overran the budget the deadline is in the past and k_sleep() returns
         * immediately (no artificial slowdown below real time). */
        frame++;
        int64_t deadline = base_ticks +
            (int64_t)((frame * CONFIG_SYS_CLOCK_TICKS_PER_SEC) / NES_FPS);
        k_sleep(K_TIMEOUT_ABS_TICKS(deadline));
    }
}

K_THREAD_DEFINE(emu_thread, EMU_STACK_SIZE,
                emu_thread_fn, NULL, NULL, NULL,
                EMU_PRIORITY, 0, 0);

/* ------------------------------------------------------------------ */
/* Main                                                                */
/* ------------------------------------------------------------------ */

int main(void)
{
    LOG_INF("NES Emulator starting on Zephyr");

    mm_reg_t bram_virt;
    device_map(&bram_virt, 0x40000000UL, 0x10000, K_MEM_CACHE_NONE);
    bram_fb = (volatile uint8_t *)bram_virt;
    LOG_INF("BRAM mapped: phys=0x40000000 virt=0x%08x", (uint32_t)bram_virt);

    if (nes_controller_init() != 0) {
        LOG_WRN("NES controller init failed — running without input");
    }

    screen_init();
    memory_init();

    if (!cartridge_read_file(ROM_PATH)) {
        LOG_ERR("Failed to load ROM: %s", ROM_PATH);
        return -1;
    }

    cpu_init();
    cpu_reset();
    ppu_init();

    if (fb_udp_init() == 0) {
        net_ready = true;
    } else {
        LOG_ERR("network init failed — framebuffer streaming disabled");
        /* Let the emulator run anyway so input/PPU still work locally. */
        net_ready = true;
    }

    LOG_INF("Emulator initialised — threads running");
    return 0;
}
```

## include/bus.h
```c
#ifndef BUS_HEADERGUARD
#define BUS_HEADERGUARD
#include <stdint.h>

typedef uint8_t byte;


extern byte controller[2];
extern byte controller_state[2];

void bus_reset();

#endif
```

## include/cartridge.h
```c
#ifndef CARTRIDGE_HEADERGUARD
#define CARTRIDGE_HEADERGUARD
#include <stdint.h>
#include "emulator_config.h"
#include "memory.h"
typedef uint8_t byte;

enum MIRROR
{
    VERTICAL,
    HORIZONTAL
};
extern Config config;


extern MIRROR mirroring;

bool cartridge_read_file(const char* rom_name);
const int PRG_BANK_SIZE = 16 * 1024;
const int CHR_BANK_SIZE = 8 * 1024;

/* iNES mapper numbers this emulator understands. */
#define MAPPER_NROM 0
#define MAPPER_MMC1 1
#define MAPPER_MMC3 4

/* Set by cartridge_read_file() so the bus (memory.cpp) can route CPU writes
 * to $8000-$FFFF into the active mapper instead of treating them as ROM. */
extern byte cart_mapper;

/* True when the cartridge has no CHR ROM and the 8 KB CHR window is RAM
 * (writable via the PPU bus). Mapper-0 games with CHR ROM leave this false. */
extern bool chr_is_ram;

/**
 * @brief Feed one CPU write to the MMC1 (mapper 1) serial port.
 *
 * MMC1 latches a value over five consecutive writes to $8000-$FFFF; this
 * drives that shift register and applies bank/mirroring changes once a
 * register completes. Only call for cart_mapper == MAPPER_MMC1.
 *
 * @param addr CPU address of the write ($8000-$FFFF); bits 14-13 select the
 *             target internal register on the fifth write.
 * @param data Byte written; bit 7 resets the shift register, bit 0 is data.
 */
void mmc1_write(uint16_t addr, byte data);

/**
 * @brief Feed one CPU write to the MMC3 (mapper 4) registers.
 *
 * Bank/mirroring/IRQ registers are selected by the address range and its low
 * bit (even/odd). Only call for cart_mapper == MAPPER_MMC3.
 *
 * @param addr CPU address of the write ($8000-$FFFF).
 * @param data Byte written.
 */
void mmc3_write(uint16_t addr, byte data);

/**
 * @brief Clock the mapper's scanline IRQ counter (MMC3).
 *
 * Call once per visible scanline while rendering is enabled. No-op for mappers
 * without a scanline counter. May set the CPU IRQ line pending.
 */
void mapper_scanline(void);




#endif
```

## include/cpu.h
```c
#ifndef HEADERGAURD_CPU_HEADER
#define HEADERGAURD_CPU_HEADER
#include <stdint.h>
#include "memory.h"
#include "emulator_config.h"
#include "bus.h"
#include "cpu_vars.h"

typedef uint8_t byte;
typedef void (*InstructionHandler)(void);
void init_instruction_handler_lut();
void build_decode_table();
extern uint32_t opcode;
struct Instruction
{
    byte aaa;
    byte bbb;
    byte cc;
    byte opcode;
    byte xx;
    byte y;
};
// CPU internal registers
extern byte A;
extern byte X;
extern byte Y;
extern uint16_t PC;
extern byte SP; // Stack pointer - Stack is in RAM
// Cpu Flags
extern byte C; // carry
extern byte Z; // zero
extern byte I; // interrupt
extern byte D; // decimal
extern byte B; // break
extern byte O; // overflow //iN DOCUMENTATION IT'S V BUT O is more intuitive
extern byte N; // negative

void cpu_init();
void cpu_reset();

byte inline pack_flags()
{
    byte to_return = 0;
    to_return |= N << 7;
    to_return |= O << 6;
    to_return |= 1 << 5;
    to_return |= B << 4;
    to_return |= D << 3;
    to_return |= I << 2;
    to_return |= Z << 1;
    to_return |= C;

    return to_return;
};
void inline unpack_flags(byte flags)
{
    N = ((1 << 7) & flags) >> 7;
    O = ((1 << 6) & flags) >> 6;
    B = 0; // break flag shouldnt change when loded with PLP
    D = ((1 << 3) & flags) >> 3;
    I = ((1 << 2) & flags) >> 2;
    Z = ((1 << 1) & flags) >> 1;
    C = 1 & flags;
    return;
}
CPU_VARS pack_vars();
// byte read_pc();
inline byte read(uint16_t address) { return cpu_read(address); }
inline void write(uint16_t address, byte data) { cpu_write(address, data); }
byte inline read_pc()
{
    byte val = read(PC++);
    // PC++;
    return val;
}
uint16_t read_address_from_pc();
uint16_t read_address(byte offset);

// extern CPU_STATE state;
void fetch_instruction();
void cpu_clock();
void cpu_execute();
uint16_t read_abs_address(uint16_t offset);
void push(byte x);
void push_address(uint16_t address);
byte pop();
uint16_t pop_address();


// First group of instructions
void branch();
void ORA(uint16_t address);
void AND(uint16_t address);
void EOR(uint16_t address);
void ADC(uint16_t address);
void STA(uint16_t address);
void LDA(uint16_t address);
void CMP(uint16_t address);
void SBC(uint16_t address);

// Second group of instructions
void ASL_acc();
void ASL(uint16_t address);
void ROL_acc();
void ROL(uint16_t address);
void LSR_acc();
void LSR(uint16_t address);
void ROR_acc();
void ROR(uint16_t address);
void STX(uint16_t address);
void LDX(uint16_t address);
void DECC(uint16_t address); // dec is defined as 10 somewhere?
void INC(uint16_t address);

// Third group of instructions
void JMP_abs(uint16_t jump_address);
void JMP_indirect(uint16_t jump_address);
void BITT(uint16_t address);
void STY(uint16_t address);
void CPY(uint16_t address);
void CPX(uint16_t address);
void LDY(uint16_t address);

// SINGLE BYTE INSTRUCTIONS
void PHP();
void PLP();
void PHA();
void PLA();
void DEY();
void TAY();
void INY();
void INX();
void CLC();
void SEC();
void CLI();
void SEI();
void TYA();
void CLV();
void CLD();
void SED();
void BRK();

void TXA();
void TXS();
void TAX();
void TSX();
void DEX();

// INTERRUPTS
void RTS();
void RTI();
void JSR_abs(uint16_t address);

// BRANCHES
void OP_BPL();
void OP_BMI();
void OP_BVC();
void OP_BVS();
void OP_BCC();
void OP_BCS();
void OP_BNE();
void OP_BEQ();

const uint16_t NMI_vector = 0xFFFA;
const uint16_t RESET_VECTOR = 0xFFFC;
const uint16_t IRQ_vector = 0xFFFE;
const uint16_t BRK_vector = 0xFFFE;

extern bool pending_nmi;
extern bool pending_irq;
void trigger_irq();
void trigger_nmi();

inline void enqueue_nmi()
{
    pending_nmi = true;
}

// addressing modes
uint16_t addr_IMM(void);
uint16_t addr_zero_page_x_p(void);
uint16_t addr_zero_page_x(void);
uint16_t addr_zero_page_y(void);
uint16_t addr_zero_page(void);
uint16_t addr_abs(void);
uint16_t addr_pzero_page_y(void);
uint16_t addr_abs_y(void);
uint16_t addr_abs_x(void);

#endif
```

## include/memory.h
```c
#ifndef MEMORY_HEADERGUARD
#define MEMORY_HEADERGUARD
#include "ppu.h"
#include "bus.h"
#include <stdint.h>
#include <string.h>
#include <stdio.h>


typedef uint8_t byte;

void memory_init();


extern byte PRGrom[0x8000];
extern byte CHRrom[0x4000];
extern byte CPUram[0x0800];
extern byte PRGram[0x2000];

byte cpu_read(uint16_t addr);
void cpu_write(uint16_t addr, byte data);


#endif
```

## include/ppu.h
```c
#ifndef HEADERGUARD_PPU
#define HEADERGUARD_PPU
#include <stdint.h>
#include "virtual_screen.h"
#include "cartridge.h"
#include "memory.h"

#define VISIBLE_SCANLINES 240
#define VISIBLE_DOTS 256
#define FRAME_END_SCANLINE 261
#define DOTS_PER_SCANLINE 341
#define LAST_SCANLINE_DOT 340

typedef uint8_t byte;

// this is size 4
struct _OAM
{
    byte y;
    byte id;
    byte attributes;
    byte x;
}; // this is how a sprite is stored

extern union PPUStatus
{
    struct
    {
        uint8_t unused : 5;          
        uint8_t sprite_overflow : 1; 
        uint8_t sprite_zero_hit : 1; 
        uint8_t vertical_blank : 1;  
    };
    byte reg;
} status;

extern union PPUmask
{
    struct
    {
        byte grayscale : 1;
        byte render_background_left : 1;
        byte render_sprites_left : 1;
        byte render_background : 1;
        byte render_sprites : 1;
        byte enhance_red : 1;
        byte enhance_green : 1;
        byte enhance_blue : 1;
    };

    byte reg;
} mask;

extern union PPUctrl
{
    struct
    {
        byte nametable_x : 1;
        byte nametable_y : 1;
        byte increment_mode : 1;
        byte pattern_sprite : 1;
        byte pattern_background : 1;
        byte sprite_size : 1;
        byte slave_mode : 1; // UNUSED
        byte enable_nmi : 1;
    };
    byte reg;
} control;

union loopy
{
    // THE X and T registers play more roles. Can either be used as address for vram or for selecting other stuff
    struct
    {
        uint16_t coarse_x : 5;
        uint16_t coarse_y : 5;
        uint16_t nametable_x : 1;
        uint16_t nametable_y : 1;
        uint16_t fine_y : 3;
        uint16_t unused : 1;
    };
    uint16_t reg;
};

extern bool pause_after_frame;
extern uint16_t current_frame;
extern bool odd_frame;

// byte bus;
extern loopy vaddr; 
// in render = scrolling position, outside of rendering = the current VRAM address
extern loopy taddr; 
// During rendering it does something. Outsdie of rendering, holds the VRAM address before transfering it to v
extern uint16_t x; 
// FINE x position of the current scroll, used during rendering alongside v
extern uint16_t w; 
// Togles on each write to PPUSCROLL or PPUADDR, indicating whether it's the first or secnon dwrite. Clears on reads of PPUSTATUS
// its also claled the write latch or write toggle

extern int16_t scanline;
extern uint16_t dots;
extern byte transparent_pixel_color;
extern bool PPUSCROLL_latch;
extern bool PPUADDR_latch;
extern bool first_write;

extern uint16_t PPUSCROLL16;
extern uint16_t PPUADDR16;
extern byte PPUDATA;
extern byte OAMDMA;
extern byte PPU_BUFFER;
extern bool even_frame;
extern _OAM OAM[64];
extern byte *pOAM; // pointer to OAM for byte by byte access
void ppu_init();


extern byte OAMADDR;
extern byte OAMDATA;
extern byte PPUSCROLL;

extern byte nametable[2][0x0400]; // mirrored
extern byte patterntable[2][0x1000];
extern byte pallete_table[32];
extern byte fine_x; // 3 bits wide! 

// rendering shift registers! they shift every PPU clock. There are 2 16bit registers
// https://www.nesdev.org/wiki/PPU_rendering


// BACKGROUND RENDEERING
extern uint16_t bgs_pattern_l;
extern uint16_t bgs_pattern_h;
extern uint16_t bgs_attribute_l;
extern uint16_t bgs_attribute_h;
extern byte bg_next_tile_id;
extern byte bg_next_tile_attrib;
extern byte bg_next_tile_lsb;
extern byte bg_next_tile_msb;

// FOREGROUND RENDERING
extern _OAM sprites_on_scanline[8]; // only 8 sprites per scanline
extern byte sprite_cnt;
extern byte sp_pattern_l[8];        // Every sprite pattern is made of 16 bits
extern byte sp_pattern_h[8];
extern bool sprite_zero_on_scanline;
void ppu_reset();
void ppu_render_scanline();
void ppu_execute();
void set_vblank_nmi();
void clear_vblank_nmi();
void set_vblank();
void clear_vblank();
byte get_status();
byte get_control();
// For main bus

byte ppu_read_from_cpu(byte addr);
void ppu_write_from_cpu(byte addr, byte data);
// for internal ppu bus

byte ppu_read(uint16_t addr);
void ppu_write(uint16_t addr, byte data);

/* Nametable mirroring modes for ppu_set_mirroring() (match MMC1 control bits). */
#define NT_MIRROR_ONE_LOWER  0
#define NT_MIRROR_ONE_UPPER  1
#define NT_MIRROR_VERTICAL   2
#define NT_MIRROR_HORIZONTAL 3

/**
 * @brief Set nametable mirroring at runtime (used by MMC1/MMC3).
 *
 * @param mode One of NT_MIRROR_ONE_LOWER, NT_MIRROR_ONE_UPPER,
 *             NT_MIRROR_VERTICAL, NT_MIRROR_HORIZONTAL.
 */
void ppu_set_mirroring(int mode);

// PPU Helper functions and variables
extern byte flip_byte[256];
void generate_flip_byte_lt();
void build_tile_cache();
void build_tile_cache_range(int first_tile, int tile_count);


void clock_shifters();

inline void load_bg_shifters();
inline void transfer_address_x();
inline void increment_scroll_y();
inline void transfer_address_y();


void init_sprites_on_scanline();
loopy build_background_scanline(int scanline_index, loopy vaddr_snapshot, byte fine_x_snapshot);

// Unused. PPU used to be a state machine, now it just renders scanline by scanline 
enum State
{
    PRE_RENDER,
    RENDER,
    POST_RENDER,
    VERTICAL_BLANK
};
extern State pipeline_state;
extern int cycle;


//Optimizations 
extern byte scanline_buffer[256];
extern byte tile_pixels[512][8][8]; //Decode CHR tiles in advance - for Mapper0 games this never changes
extern bool tile_cache_initialized;
byte ppu_read_nametable_tile(byte nt_x, byte nt_y, byte coarse_x, byte coarse_y);
#endif
```
